## drivers/entropy/Kconfig
```kconfig
# Arm CC3xx entropy driver for nRF52840 and nRF9160
#
# Copyright (c) 2019 Nordic Semiconductor
#
# SPDX-License-Identifier: LicenseRef-Nordic-5-Clause

config ENTROPY_CC3XX
	bool "Arm CC3XX RNG driver for Nordic devices"
	# TODO: CRYPTOCELL_USABLE is set when BUILD_WITH_TFM=y (probably same for SPM)
	# Continue with cryptocell-usable rework in nrfxlib
	depends on CRYPTOCELL_USABLE || SPM_SERVICE_RNG || TFM_CRYPTO_RNG_MODULE_ENABLED
	depends on ENTROPY_GENERATOR
	select ENTROPY_HAS_DRIVER
	default y
	help
	  This option enables the Arm CC3xx RNG devices in nRF52840, nRF5340, and nRF9160
	  devices. This is dependent on CC3xx being enabled in nrf_security.
	  This is required for TF-M builds using NORDIC_SECURITY_BACKEND.
```

## modules/lib/matter/config/nrfconnect/chip-module/Kconfig.defconfig
```kconfig
if CHIP

if CHIP_WIFI

config MBEDTLS_PSA_CRYPTO_EXTERNAL_RNG
    default n

config MBEDTLS_SSL_OUT_CONTENT_LEN
    default 900

endif # CHIP_WIFI

# Enable mbedTLS from nrf_security library

config PSA_CRYPTO_DRIVER_CC3XX
	default n

config OBERON_BACKEND
    default y

config MBEDTLS_ENABLE_HEAP
    default y

config MBEDTLS_HEAP_SIZE
    default 15360

config MBEDTLS_TLS_LIBRARY
    default y

config NRF_SECURITY_ADVANCED
    default y

config MBEDTLS_AES_C
    default y

config MBEDTLS_ECP_C
    default y

config MBEDTLS_ECP_DP_SECP256R1_ENABLED
    default y

config MBEDTLS_CTR_DRBG_C
    default y

config MBEDTLS_CIPHER_MODE_CTR
    default y

config MBEDTLS_ECJPAKE_C
    default y

config MBEDTLS_SHA256_C
    default y

config MBEDTLS_PK_C
    default y

config MBEDTLS_PK_WRITE_C
    default y

config MBEDTLS_X509_CREATE_C
    default y if !CHIP_CRYPTO_PSA

config MBEDTLS_X509_CSR_WRITE_C
    default y if !CHIP_CRYPTO_PSA

# Disable unneeded crypto operations

config MBEDTLS_SHA384_C
    default n

config MBEDTLS_SHA512_C
    default n

config MBEDTLS_CIPHER_MODE_XTS
    default n

config MBEDTLS_CHACHA20_C
    default n

config MBEDTLS_POLY1305_C
    default n

config MBEDTLS_CHACHAPOLY_C
    default n

config MBEDTLS_GCM_C
    default n

config MBEDTLS_RSA_C
    default n

config PSA_WANT_KEY_TYPE_CHACHA20
    default n

config PSA_WANT_ALG_GCM
    default n

config PSA_WANT_ALG_CHACHA20_POLY1305
    default n

config PSA_WANT_ALG_SHA_1
    default n

config PSA_WANT_ALG_SHA_224
    default n

config PSA_WANT_ALG_SHA_384
    default n

config PSA_WANT_ALG_SHA_512
    default n

config PSA_WANT_ALG_RIPEMD160
    default n

config PSA_WANT_ALG_MD5
    default n

config PSA_WANT_ALG_CFB
    default n

config PSA_WANT_ALG_OFB
    default n

endif # CHIP
```

## modules/lib/matter/config/zephyr/chip-module/Kconfig.defaults
```kconfig
if CHIP

# Enable mbedTLS
config MBEDTLS_ENABLE_HEAP
	bool
	default y

config MBEDTLS_HEAP_SIZE
	int
	default 15360

endif # CHIP
```

## modules/tfm/zephyr/Kconfig
```kconfig
#
# Copyright (c) 2021 Nordic Semiconductor ASA
#
# SPDX-License-Identifier: LicenseRef-Nordic-5-Clause
#

config TFM_BOARD
	string
	default "${ZEPHYR_NRF_MODULE_DIR}/modules/tfm/tfm/boards/nrf9160" if SOC_NRF9160
	default "${ZEPHYR_NRF_MODULE_DIR}/modules/tfm/tfm/boards/nrf9120" if SOC_NRF9120
	default "${ZEPHYR_NRF_MODULE_DIR}/modules/tfm/tfm/boards/nrf5340_cpuapp" if SOC_NRF5340_CPUAPP
	depends on TRUSTED_EXECUTION_NONSECURE
	help
	  Redefinition of TFM_BOARD to use out-of-tree boards. These depend on
	  ${TFM_BOARD_BASE_DIR} being set to the TFM board dir inside sdk-nrf.
```

## tests/crypto/testcase.yaml
```yaml
# Test timeouts were determined by rounding nRF52840-DK times up to
# the next 100 seconds.
tests:
  test_sw:
    extra_args: OVERLAY_CONFIG=overlay-backend-sw.conf
    platform_whitelist: nrf52840dk_nrf52840 nrf9160dk_nrf9160
    tags: crypto ci_build
    timeout: 600
  test_hw:
    extra_args: OVERLAY_CONFIG=overlay-backend-hw.conf
    platform_whitelist: nrf52840dk_nrf52840 nrf9160dk_nrf9160
    tags: crypto ci_build
    timeout: 100
  test_sw_hw:
    extra_args: OVERLAY_CONFIG=overlay-backend-hw-sw.conf
    platform_whitelist: nrf52840dk_nrf52840 nrf9160dk_nrf9160
    tags: crypto ci_build
    timeout: 200
```
